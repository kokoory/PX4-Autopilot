## src/drivers/rpm/as5047/Kconfig
```kconfig
menuconfig DRIVERS_RPM_AS5047
	bool "as5047"
	default n
	---help---
		Enable support for AS5047P magnetic rotary encoder RPM sensor (SPI)
```

## src/drivers/rpm/as5048b/Kconfig
```kconfig
menuconfig DRIVERS_RPM_AS5048B
	bool "as5048b"
	default n
	---help---
		Enable support for AS5048B magnetic rotary encoder RPM sensor
```
